## fs/aufs/Kconfig
```kconfig
# SPDX-License-Identifier: GPL-2.0
config AUFS_FS
	bool "Aufs (Advanced multi layered unification filesystem) support"
	help
	Aufs is a stackable unification filesystem such as Unionfs,
	which unifies several directories and provides a merged single
	directory.
	In the early days, aufs was entirely re-designed and
	re-implemented Unionfs Version 1.x series. Introducing many
	original ideas, approaches and improvements, it becomes totally
	different from Unionfs while keeping the basic features.

if AUFS_FS
choice
	prompt "Maximum number of branches"
	default AUFS_BRANCH_MAX_127
	help
	Specifies the maximum number of branches (or member directories)
	in a single aufs. The larger value consumes more system
	resources and has a minor impact to performance.
config AUFS_BRANCH_MAX_127
	bool "127"
	help
	Specifies the maximum number of branches (or member directories)
	in a single aufs. The larger value consumes more system
	resources and has a minor impact to performance.
config AUFS_BRANCH_MAX_511
	bool "511"
	help
	Specifies the maximum number of branches (or member directories)
	in a single aufs. The larger value consumes more system
	resources and has a minor impact to performance.
config AUFS_BRANCH_MAX_1023
	bool "1023"
	help
	Specifies the maximum number of branches (or member directories)
	in a single aufs. The larger value consumes more system
	resources and has a minor impact to performance.
config AUFS_BRANCH_MAX_32767
	bool "32767"
	help
	Specifies the maximum number of branches (or member directories)
	in a single aufs. The larger value consumes more system
	resources and has a minor impact to performance.
endchoice

config AUFS_SBILIST
	bool
	depends on AUFS_MAGIC_SYSRQ || PROC_FS
	default y
	help
	Automatic configuration for internal use.
	When aufs supports Magic SysRq or /proc, enabled automatically.

config AUFS_HNOTIFY
	bool "Detect direct branch access (bypassing aufs)"
	help
	If you want to modify files on branches directly, eg. bypassing aufs,
	and want aufs to detect the changes of them fully, then enable this
	option and use 'udba=notify' mount option.
	Currently there is only one available configuration, "fsnotify".
	It will have a negative impact to the performance.
	See detail in aufs.5.

if AUFS_HNOTIFY
choice
	prompt "method"
	default AUFS_HFSNOTIFY
config AUFS_HFSNOTIFY
	bool "fsnotify"
	select FSNOTIFY
endchoice
endif

config AUFS_EXPORT
	bool "NFS-exportable aufs"
	depends on EXPORTFS
	help
	If you want to export your mounted aufs via NFS, then enable this
	option. There are several requirements for this configuration.
	See detail in aufs.5.

config AUFS_INO_T_64
	bool
	depends on AUFS_EXPORT
	depends on 64BIT && !(ALPHA || S390)
	default y
	help
	Automatic configuration for internal use.
	/* typedef unsigned long/int __kernel_ino_t */
	/* alpha and s390x are int */

config AUFS_XATTR
	bool "support for XATTR/EA (including Security Labels)"
	help
	If your branch fs supports XATTR/EA and you want to make them
	available in aufs too, then enable this opsion and specify the
	branch attributes for EA.
	See detail in aufs.5.

config AUFS_FHSM
	bool "File-based Hierarchical Storage Management"
	help
	Hierarchical Storage Management (or HSM) is a well-known feature
	in the storage world. Aufs provides this feature as file-based.
	with multiple branches.
	These multiple branches are prioritized, ie. the topmost one
	should be the fastest drive and be used heavily.

config AUFS_RDU
	bool "Readdir in userspace"
	help
	Aufs has two methods to provide a merged view for a directory,
	by a user-space library and by kernel-space natively. The latter
	is always enabled but sometimes large and slow.
	If you enable this option, install the library in aufs2-util
	package, and set some environment variables for your readdir(3),
	then the work will be handled in user-space which generally
	shows better performance in most cases.
	See detail in aufs.5.

config AUFS_DIRREN
	bool "Workaround for rename(2)-ing a directory"
	help
	By default, aufs returns EXDEV error in renameing a dir who has
	his child on the lower branch, since it is a bad idea to issue
	rename(2) internally for every lower branch. But user may not
	accept this behaviour. So here is a workaround to allow such
	rename(2) and store some extra information on the writable
	branch. Obviously this costs high (and I don't like it).
	To use this feature, you need to enable this configuration AND
	to specify the mount option `dirren.'
	See details in aufs.5 and the design documents.

config AUFS_SHWH
	bool "Show whiteouts"
	help
	If you want to make the whiteouts in aufs visible, then enable
	this option and specify 'shwh' mount option. Although it may
	sounds like philosophy or something, but in technically it
	simply shows the name of whiteout with keeping its behaviour.

config AUFS_BDEV_LOOP
	bool
	depends on BLK_DEV_LOOP
	default y
	help
	Automatic configuration for internal use.
	Convert =[ym] into =y.

config AUFS_DEBUG
	bool "Debug aufs"
	help
	Enable this to compile aufs internal debug code.
	It will have a negative impact to the performance.

config AUFS_MAGIC_SYSRQ
	bool
	depends on AUFS_DEBUG && MAGIC_SYSRQ
	default y
	help
	Automatic configuration for internal use.
	When aufs supports Magic SysRq, enabled automatically.
endif
```
